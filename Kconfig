## Kconfig
```kconfig
menu "ESP_RTL_SDR-ESP"

    config ESP_RTL_SDR_ESP_ENABLED
        bool "Enable ESP_RTL_SDR-ESP driver"
        default y
        help
            USB Host client for official RTL-SDR Blog V4.

    config ESP_RTL_SDR_ESP_DEFAULT_TRANSFER_BYTES
        int "Default bulk transfer size (bytes)"
        default 16384
        range 512 262144
        help
            Gate 2 multi-URB default is 16384. Tab5 may override to 32768.

    config ESP_RTL_SDR_ESP_DEFAULT_TRANSFER_COUNT
        int "Default number of bulk buffers"
        default 6
        range 2 8

    config ESP_RTL_SDR_ESP_LOG_VERBOSE
        bool "Verbose driver logs"
        default n

    choice ESP_RTL_SDR_ESP_R820T2_IF_MODE
        prompt "R820T2 IF filter and IF for the sample rate"
        default ESP_RTL_SDR_ESP_R820T2_IF_TABLE
        help
            How R820T2 profiles (Blog V3, Nooelec SMArt v5) set the tuner IF filter
            (reg 0x0a/0x0b) and the IF (demod IF and PLL LO offset) for the sample rate.
            See docs/KCONFIG.md for the values each choice gives and an A/B procedure.

        config ESP_RTL_SDR_ESP_R820T2_IF_TABLE
            bool "Driver table (default; Oldenburger-derived, hand-edited above 1.5 MS/s)"
            help
                The table the driver has shipped since it started following the sample
                rate. 250k: 0xe8 / 1.70 MHz IF, 2048k: 0x8f / 1.75 MHz.

        config ESP_RTL_SDR_ESP_R820T2_IF_LIBRTLSDR
            bool "librtlsdr r82xx_set_bandwidth (osmocom / rtl-sdr-blog)"
            help
                What osmocom librtlsdr and rtl-sdr-blog compute, and what the vendor DLL
                writes on a Blog V4 at every rate. 250k: 0xe6 / 2.125 MHz IF, 2048k:
                0xaf / 1.625 MHz, above 2.43 MS/s 0x6b / 3.57 MHz with reg 0x0a bit 4 set.

        config ESP_RTL_SDR_ESP_R820T2_IF_VENDOR_FIXED
            bool "Vendor fixed (wide filter, 3.57 MHz IF at every rate)"
            help
                What the vendor DLL leaves on a Blog V3c or Nooelec v5 after a cold open,
                and what upstream esp-rtl-sdr does: reg 0x0a bit 4 set, 0x0b = 0x6b,
                3.57 MHz IF, whatever the rate.
    endchoice

endmenu
```
